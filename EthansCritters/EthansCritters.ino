// Ethan's Critters - a swamp that was cute until it started biting back.
//
// A squire explores one big swamp and clears out the critter nests in it.
// The game is also an experiment: how far can unique art and animation go
// when it is streamed from the SD card every frame, on a 48 MHz RISC-V with
// 20 KB of RAM, a 128x128 panel and the card on the panel's SPI bus?
//
// The frame loop (CHGame's, with the card in it):
//   logic ticks at a fixed 60 Hz, while the previous frame goes out by DMA;
//   gfx_wait(): SPI1 and the framebuffer are free;
//   the card is read (only here, until the flush);
//   drawing;
//   gfx_flushAsync().
//
// Logic always ticks at 60 Hz; the play screen is drawn at 60 fps, or at
// 30 while the work after gfx_wait() does not fit (src/engine/Pace.h).
//
// The screens: boot -> the card check (what is wrong with the card, A
// tries again; the first time a card's data is seen it is read through
// once behind a bar, as a card stalls on its first read of fresh data:
// WARM) -> the title, a full-screen loop streamed from CRITTERS.DAT
// into the framebuffer every frame (Path F), the best time and PRESS A on
// top (with progress saved, Save.h: CONTINUE or NEW GAME) -> (A) play: the
// squire in the swamp, streamed from the card every frame, the critters,
// the nests, the toad; its pause map, death and win clips (src/game/Play.h).
// After the win clip A comes back here. B on the title: the sprite lab (in
// the simulator only: config.h's ECRT_LAB; src/ui/Lab.h).
#include "src/Size.h"       // (first: Size.h)
#include <CHGame.h>
#include <Fat.h>
#include "config.h"
#include "src/assets/Palette.h"     // PALETTE, C_* (generated by tools/assets/quantise.py)
#include "src/assets/CardIndex.h"   // the card's sections (generated by tools/mkcard.py)
#include "src/assets/WorldData.h"   // the world's terrain, regions, start (tools/world/paint.py)
#include "src/engine/Card.h"
#include "src/engine/PathF.h"
#include "src/engine/Pace.h"
#include "src/engine/Spool.h"
#include "src/game/Play.h"
#include "src/ui/Hud.h"             // hud::centred
#include "src/ui/Lab.h"             // the sprite lab (in the simulator)
#include "Sounds.h"                 // Sfx, sfx(), the title's tune
#ifdef CHSIM
#include "sim.h"                    // sim_cardEject: the X command
#endif

// BOOT shows a frame at once; OPEN reads the card (up to a second's wait
// on a cold card) behind it; WARM reads a new card's file through once.
enum Screen : uint8_t { BOOT, OPEN, CARD, WARM, TITLE, PLAY, LAB };
static Screen screen;               // zero: BOOT
static card::Status why;            // what the card screen says
static uint8_t edges;               // buttons pressed since the last drawn frame (for the screens that act while drawing)
static uint8_t sinceDraw;           // logic ticks since the last drawn frame
static uint32_t warmK;              // WARM: the next block of the file to read
#if ECRT_EXTRAS
static bool fresh;                  // the title's choice (with progress saved): NEW GAME, else CONTINUE
#endif

// The card, from the top: on to the title (a card this board has not read
// through yet: first that, WARM), or to the card screen saying why not.
static void tryCard() {
    why = card::open();             // (with CHSd's long timeout: Card.h)
    spool::begin(CARD_BANK_FIRST);  // the frame cache starts again with the card
    if (!why) {
        if (!play::warmed()) {
            warmK = 0;
            screen = WARM;
            return;
        }
        if (pathf::open(CARD_TITL_FIRST)) {
            card::steady();         // every frame streams from here: a stall costs a frame, not a second
            screen = TITLE;
            playSong(Song::Title);
            return;
        }
        // the card stalled (Card.h: A tries again), or no clip where CardIndex.h says
        why = card::status() ? card::status() : card::fails ? card::NO_CARD : card::BAD_DATA;
    }
    screen = CARD;
    pal::init(PALETTE);             // the clip may have set its own
}

#if CHGAME_DEBUG
// Debug commands: X0 pulls the card out, X1 puts it back (as CHWords does;
// the simulator only); W x y starts a walk with the squire at world (x, y);
// the rest go to the screen (Play.h: Z, J, C, H, D, A, I, O; Lab.h: H, R,
// Z, C, F, M).
static bool hook(char cmd, const char *args) {
#ifdef CHSIM
    if (cmd == 'X') {
        sim_cardEject(args[0] == '0');
        return true;
    }
#endif
    if (cmd == 'W' && screen >= TITLE) {
        playSong(Song::None);
        int x = (int)dbg::parseNum(args, 10);
        play::enter((int16_t)x, (int16_t)dbg::parseNum(args, 10));
        screen = PLAY;
        return true;
    }
    if (screen == PLAY) return play::hook(cmd, args);
#if ECRT_LAB
    if (screen == LAB) return lab::hook(cmd, args);
#endif
    return false;
}
#endif

void setup() {
    chgame.boot();
    dbg::begin("ECRT " ECRT_VERSION);
#if CHGAME_DEBUG
    dbg::hook = hook;
#endif
    gfx_begin(GFX_DIV2, GFX_12BPP);
    pal::init(PALETTE);
    pal::setCycling(false);
    soundsBegin();
    play::boot();                   // the saved progress
    chgame.setFrameRate(ECRT_FPS);
}

// --- the card screen ------------------------------------------------------------

// Two big lines and a hint, by card::Status from NO_CARD on (the screen
// never says READY), each ended by a 0: one string and no table of
// pointers (40 B less). (A lean debug build, config.h, leaves the hints out:
// the big lines say enough on a desk.)
#if ECRT_LEAN
#define HINT(s) "\0"
#else
#define HINT(s) s "\0"
#endif
static const char WHY[] =
    "INSERT\0CARD\0" HINT("THE SD CARD WITH CRITTERS.DAT")
    "CARD\0NOT FAT\0" HINT("FORMAT IT FAT32, COPY THE FILE")
    "NO\0CRITTERS.DAT\0" HINT("COPY IT TO THE CARD'S ROOT")
    "COPY TO A\0FRESH CARD\0" HINT("THE FILE IS IN TOO MANY PIECES")
    "WRONG\0CARD DATA\0" HINT("COPY THIS BUILD'S CRITTERS.DAT");
#undef HINT

// The card screen's line k (0..2) for why.
static const char *whyLine(uint32_t k) {
    const char *p = WHY;
    for (k += (why - 1u) * 3; k; k--)
        while (*p++) {}
    return p;
}

// Packed mud. No card art here: the art is on the card. (The name over it
// and the board the card screen's words were nailed to went for flash, for
// the sword's swipe: the words stand on the mud.)
static void drawMud() {
    gfx_clear(C_UMBER);
#if !ECRT_LEAN                      // (a lean debug build: plain mud)
    uint32_t r = 0x2545F491u;       // the same speckles every frame
    for (uint32_t i = 0; i < 700; i++) {
        r ^= r << 13; r ^= r >> 17; r ^= r << 5;
        gfx_pixel((int)(r & 127), (int)((r >> 7) & 127), (r >> 14) & 3 ? C_PEAT : C_SOOT);
    }
#endif
}

// The mud, saying what is wrong and what to do.
static void drawCard() {
    drawMud();
    hud::centred2(40, whyLine(0));
    hud::centred2(56, whyLine(1));
    hud::centred(96, whyLine(2), C_MUD);
    if (chgame.frameCount % 60 < 40) hud::centred(112, "A: TRY AGAIN", C_BONE);
}

// The card went away in the middle of a screen (card::status() says how): say so.
static void cardGone() {
    why = card::status();
    screen = CARD;
    pal::init(PALETTE);
    drawCard();
}

// --- the warm-up ---------------------------------------------------------------------

// The board stalled ~1.05 s once on its first read of a freshly written
// CRITTERS.DAT (the card settling the new data; never again after). So the
// first time a card's data is seen (play::warmed()) the whole file is read
// once here, with the long timeout, behind a bar: STIRRING THE SWAMP. Long
// streams (WARM_STEP blocks, one command each but where the file's runs
// split), then a flush for the bar: ~2.1 MB/s on the board (the wire's
// 2.3 less the flushes): 6.4 MB in ~3 s. Its frames come as fast as the
// card goes, not on the 60 Hz ticks (nothing on this screen moves), so the
// scripts' frames do not move with it. A stream that fails is a frame lost
// like any other (Card.h). At the end the mark is saved and the card
// opened again (the title).
static const uint32_t WARM_STEP = 512;
static const int BAR_X = 24, BAR_Y = 70, BAR_W = 80;

#if CHGAME_DEBUG
static uint32_t warmT0;             // micros() at its start: it says how long it took (WARM ms=)
#endif

static bool warm() {
    if (!warmK) {                   // the screen, once: the bar grows on it
        drawMud();
        hud::centred(58, "STIRRING THE SWAMP", C_MUD);
#if !ECRT_LEAN                      // (a lean debug build: no bar, M8d)
        gfx_fillRect(BAR_X - 1, BAR_Y - 1, BAR_W + 2, 5, C_SOOT);
#endif
#if CHGAME_DEBUG
        warmT0 = micros();
#endif
    }
    uint32_t n = CARD_BLOCKS - warmK;
    if (n > WARM_STEP) n = WARM_STEP;
    if (!card::stream(warmK, n, [](const uint8_t *, void *) {}, nullptr)) return false;
    warmK += n;
#if !ECRT_LEAN
    gfx_fillRect(BAR_X, BAR_Y, (int)(warmK * BAR_W / CARD_BLOCKS), 3, C_OCHRE);
#endif
    if (warmK >= CARD_BLOCKS) {
        play::markWarmed();
        screen = OPEN;
#if CHGAME_DEBUG
        char buf[40];
        fmtStr(fmtInt(fmtStr(fmtInt(fmtStr(buf, "WARM ms="), (int32_t)((micros() - warmT0) / 1000)), " lost="),
                      card::lost), "\n");
        dbg::print(buf);
#endif
    }
    return true;
}

// --- the title --------------------------------------------------------------------

// The loop comes from the card every frame (the framebuffer is the only
// copy, and the words go over it): 16 blocks, about 4 ms on the board.
// Under it the best time, once there is one; then PRESS A, or with
// progress saved the choice, CONTINUE or NEW GAME (the d-pad picks; a
// lean debug build has neither: PRESS A carries on).
static bool drawTitle() {
    if (!pathf::play(chgame.frameCount, true)) return false;   // a frame lost, or the card gone
    bool on = chgame.frameCount % 60 < 40;
#if ECRT_EXTRAS
    if (play::best()) {
        char buf[16];               // "BEST " and mmss: up to 7-digit minutes (12 B overflowed from 1000 minutes on)
        play::mmss(fmtStr(buf, "BEST "), play::best());
        hud::centred(108, buf, C_MUD);
    }
    if (play::saved()) {
        text35s(14, 117, "CONTINUE", fresh ? C_PEAT : on ? C_BONE : C_MUD, C_SOOT);
        text35s(80, 117, "NEW GAME", !fresh ? C_PEAT : on ? C_BONE : C_MUD, C_SOOT);
        return true;
    }
#endif
    if (on) hud::centred(117, "PRESS A", C_BONE);
    return true;
}

// --- the frame loop ------------------------------------------------------------------

// One logic step (60 Hz), while the last frame is still on the wire.
static void tick() {
    chgame.pollButtons();
    edges |= chgame.justPressedMask();
    pal::tick();
    if (screen == TITLE) {
#if ECRT_LAB
        if (chgame.justPressed(B_BUTTON)) {
            playSong(Song::None);
            lab::enter();
            screen = LAB;
        } else
#endif
#if ECRT_EXTRAS                     // LEFT: CONTINUE, RIGHT: NEW GAME (as they stand), up or down: the other
        if (uint8_t m = chgame.justPressedMask() & (UP_BUTTON | DOWN_BUTTON | LEFT_BUTTON | RIGHT_BUTTON))
            fresh = m & LEFT_BUTTON ? false : m & RIGHT_BUTTON ? true : !fresh;
#endif
        if (chgame.justPressed(A_BUTTON)) {
            playSong(Song::None);
#if ECRT_EXTRAS
            if (fresh || !play::saved()) play::newGame();
            fresh = false;
#endif
            play::enter(START_X, START_Y);
            screen = PLAY;
        }
    } else if (screen == PLAY) {
        if (!play::tick()) screen = OPEN;   // after the win clip: the title again
    }
#if ECRT_LAB
    else if (screen == LAB) {
        if (!lab::tick()) screen = OPEN;
    }
#endif
}

void loop() {
    // The warm-up's frames come as fast as the card goes, and the debug
    // protocol waits for them (so a script's commands land on the same frames).
    if (screen != WARM) {
        dbg::poll();
        if (!chgame.nextFrame()) return;
        dbg::markUpdateStart();
        // A slow frame is caught up (up to three ticks) before the next is drawn.
        // While the card holds the screen (frames lost in a row: Card.h) the game
        // waits with it, so nothing happens that is not seen.
        uint8_t n = 0;
        do
            if (card::fails < card::HOLD) tick();
        while (++n < 3 && chgame.nextFrame());
        sinceDraw = (uint8_t)(sinceDraw + n);
        if (screen == PLAY && pace::half() && sinceDraw < 2) {    // 30 fps: every second tick
            dbg::poll();                // answer a lockstep N now: the simulator waits for a flush or an answer
            return;
        }
        sinceDraw = 0;
        if (screen == PLAY) play::plan();   // what the frame cache must hold by the drawing
#if ECRT_LAB
        else if (screen == LAB) lab::plan();
#endif
    }

    gfx_wait();                         // from here to the flush: SPI1, the fb and the chunk scratch are ours
    dbg::markRenderStart();
    pace::start();
    bool whole = true;                  // false: a card stream failed (Card.h), the frame is lost
    if (screen == BOOT) {
        drawMud();
#if !ECRT_LEAN                      // (a lean debug build: the mud alone, M8d)
        hud::centred(60, "READING THE CARD", C_MUD);
#endif
        screen = OPEN;
    } else if (screen == PLAY) {
        whole = play::draw();
    }
#if ECRT_LAB
    else if (screen == LAB) {
        whole = lab::draw();
    }
#endif
    else {
        if (screen == OPEN || (screen == CARD && (edges & A_BUTTON))) tryCard();
        if (screen == TITLE) whole = drawTitle();
        else if (screen == WARM) whole = warm();
        else drawCard();
    }
    edges = 0;
    if (!whole && card::status()) {     // given up on: the card screen
        cardGone();
        whole = true;
    }
    if (!whole) {                       // a lost frame is not sent (half of it is the last one's): the panel keeps the last
#ifdef CHSIM
        sim_present();                  // (the simulator's lockstep waits for a sketch that stops drawing)
#endif
        return;
    }
    card::fails = 0;
    pal::commit();
    if (screen == PLAY) pace::end();
    dbg::markRenderEnd();
    gfx_flushAsync();
}
